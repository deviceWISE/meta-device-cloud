## conf/layer.conf
```bitbake
# We might have a conf and classes directory, append to BBPATH
BBPATH .= ":${LAYERDIR}"

# We have recipes directories, add to BBFILES
BBFILES += "${LAYERDIR}/recipes*/*/*.bb ${LAYERDIR}/recipes*/*/*.bbappend"

BBFILE_COLLECTIONS += "meta-hdc"
BBFILE_PATTERN_meta-hdc := "^${LAYERDIR}/"
BBFILE_PRIORITY_meta-hdc = "7"

# This should only be incremented on significant changes that will
# cause compatibility issues with other layers
LAYERVERSION_meta-hdc = "1"

LAYERDEPENDS_meta-hdc = "core openembedded-layer"

LICENSE_PATH += "${LAYERDIR}/licenses"
```
